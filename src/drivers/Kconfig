## src/drivers/Kconfig
```kconfig
menuconfig JAYANT_VOLTAGE_SENSOR
	bool "Enable Jayant Voltage Sensor"
	default n

if JAYANT_VOLTAGE_SENSOR

config JAYANT_VOLTAGE_SENSOR_INIT_PRIORITY
	int "Jayant Voltage Sensor init priority"
	default KERNEL_INIT_PRIORITY_DEVICE
	help
	  ADC driver device initialization priority.

module = JAYANT_VOLTAGE_SENSOR
module-str = Jayant Voltage Sensor
source "subsys/logging/Kconfig.template.log_config"

endif # JAYANT_VOLTAGE_SENSOR


menuconfig JAYANT_BLINK_LED
	bool "Enable Jayant Blink LED"
	default n

if JAYANT_BLINK_LED

config JAYANT_BLINK_LED_PRIORITY
	int "Jayant Blink LED init priority"
	default KERNEL_INIT_PRIORITY_DEVICE
	help
	  Must be initialized after gpio and counter
endif # JAYANT_BLINK_LED
```

## src/drivers/Kconfig.voltage_sensor
```kconfig
menuconfig JAYANT_VOLTAGE_SENSOR
	bool "Enable Jayant Voltage Sensor"
	default n

if JAYANT_VOLTAGE_SENSOR

config JAYANT_VOLTAGE_SENSOR_INIT_PRIORITY
	int "Jayant Voltage Sensor init priority"
	default KERNEL_INIT_PRIORITY_DEVICE
	help
	  ADC driver device initialization priority.

module = JAYANT_VOLTAGE_SENSOR
module-str = Jayant Voltage Sensor
source "subsys/logging/Kconfig.template.log_config"

endif # JAYANT_VOLTAGE_SENSOR
```
